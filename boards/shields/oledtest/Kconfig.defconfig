## boards/shields/oledtest/Kconfig.defconfig
```kconfig
if SHIELD_OLEDTEST

config ZMK_KEYBOARD_NAME
    default "oledtest"

endif

if ZMK_DISPLAY

config I2C
    default y

config SSD1306
    default y

endif # ZMK_DISPLAY
```
